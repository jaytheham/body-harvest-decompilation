/* Body Harvest (U) linker script
 * generated by n64split v0.4a - N64 ROM splitter */

OUTPUT_ARCH (mips)

SECTIONS
{
	/* header and boot */
	.header 0x0 : AT(0x0) {
		* (.header);
		* (.boot);
	}

	/* 0x80000450 001050-02EA10 [2DA10] */
	.text80000450 0x80000400 : AT(0x001000) SUBALIGN(4) {
		* (.text80000400);
		build/src/base/EF98.o(.text);
		* (.text8000EFB8);
		build/src/base/F618.o(.text);
		* (.text8000F648);
	}

	/* Functions that don't produce 1:1 asm */
	/*.3584 0x80004184 : AT(0x003584) SUBALIGN(4) {
		build/src/base/3584.o(.text);
	}
	.EF10 0x8000EF10 : AT(0x00FB10) SUBALIGN(4) {
		build/src/base/EF10.o(.text);
	}
	.EFB8 0x8000EFB8 : AT(0x00FBB8) SUBALIGN(4) {
		build/src/base/EFB8.o(.text);
	}*/

	/* 0x80070270 040720-060E5C [2073C] */
	.text80070270 0x80070270 : AT(0x040720) {
		* (.text80070270);
	}

	/* 0x802D4CD0 18D7E0-195C80 [84A0] */
	.text802D4CD0 0x802D4CD0 : AT(0x18D7E0) {
		* (.text802D4CD0);
	}
}
